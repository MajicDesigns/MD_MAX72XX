/*
MD_MAX72xx - Library for using a MAX7219/7221 LED matrix controller

See header file for comments

This file contains methods that work with the fonts and characters defined in the library

Copyright (C) 2012-14 Marco Colli. All rights reserved.

This library is free software; you can redistribute it and/or
modify it under the terms of the GNU Lesser General Public
License as published by the Free Software Foundation; either
version 2.1 of the License, or (at your option) any later version.

This library is distributed in the hope that it will be useful,
but WITHOUT ANY WARRANTY; without even the implied warranty of
MERCHANTABILITY or FITNESS FOR A PARTICULAR PURPOSE.  See the GNU
Lesser General Public License for more details.

You should have received a copy of the GNU Lesser General Public
License along with this library; if not, write to the Free Software
Foundation, Inc., 51 Franklin St, Fifth Floor, Boston, MA 02110-1301 USA
 */
#include <Arduino.h>
#include "MD_MAX72xx.h"
#include "MD_MAX72xx_lib.h"

/**
 * \file
 * \brief Implements font definition and methods
 */

#if USE_LOCAL_FONT
// Local font handling functions if the option is enabled

void MD_MAX72XX::setFontInfoDefault(void)
// Set the defaults for the info block compatible with version 0 of the file
{
  _fontInfo.version = 0;
  _fontInfo.height = 8;
  _fontInfo.widthMax = 0;
  _fontInfo.firstASCII = 0;
  _fontInfo.lastASCII = 255;
  _fontInfo.dataOffset = 0;
}

void MD_MAX72XX::loadFontInfo(void)
{
  uint8_t c;
  uint16_t offset = 0;
  
  setFontInfoDefault();

  if (_fontData != nullptr)
  {
    PRINTS("\nLoading font info");
    // Read the first character. If this is not the file type indicator
    // then we have a version 0 file and the defaults are ok, otherwise 
    // read the font info from the data table. 
    c = pgm_read_byte(_fontData + offset++);
    if (c == FONT_FILE_INDICATOR)
    {
      c = pgm_read_byte(_fontData + offset++);  // read the version number
      switch (c)
      {
        case 1:
          _fontInfo.firstASCII = pgm_read_byte(_fontData + offset++);
          _fontInfo.lastASCII  = pgm_read_byte(_fontData + offset++);
          _fontInfo.height     = pgm_read_byte(_fontData + offset++);
          break;
        
        case 0:
        default:
          // nothing to do
          break;
      }
      _fontInfo.dataOffset = offset;
      _fontInfo.widthMax = getFontWidth();
    }
  }
}

uint8_t MD_MAX72XX::getFontWidth(void)
{
  uint8_t   max = 0;
  uint8_t   charWidth;
  uint16_t  offset = _fontInfo.dataOffset;

  PRINTS("\nFinding max font width");
  if (_fontData != nullptr)
  {
    for (uint16_t i = _fontInfo.firstASCII; i <= _fontInfo.lastASCII; i++)
    {
      charWidth = pgm_read_byte(_fontData + offset);
      /*
      PRINT("\nASCII '", i);
      PRINT("' offset ", offset);
      PRINT("' width ", charWidth);
      */
      if (charWidth > max)
      {
        max = charWidth;
        PRINT(":", max);
      }
      offset += charWidth;  // skip character data
      offset++; // skip size byte
    }
  }
  PRINT(" max ", max);

  return(max);
}

int16_t MD_MAX72XX::getFontCharOffset(uint8_t c)
{
  int16_t  offset = _fontInfo.dataOffset;

  PRINT("\nfontOffset ASCII ", c);

  if (c < _fontInfo.firstASCII || c > _fontInfo.lastASCII)
    offset = -1;
  else
  {
    for (uint8_t i=_fontInfo.firstASCII; i<c; i++)
    {
      PRINTS(".");
      offset += pgm_read_byte(_fontData+offset);
      offset++; // skip size byte we used above
    }

    PRINT(" searched offset ", offset);
    return(offset);
  }
}

bool MD_MAX72XX::setFont(fontType_t *f)
{
  if (f != _fontData) // we actually have a change to process
  {
    _fontData = (f == nullptr ? _sysfont_var : f);
    loadFontInfo();
  }

  return(true);
}

uint8_t MD_MAX72XX::getChar(uint8_t c, uint8_t size, uint8_t *buf)
{
  PRINT("\ngetChar: '", (char)c);
  PRINT("' ASC ", c);
  PRINT(" - bufsize ", size);

  if (buf == nullptr)
    return(0);

  int16_t offset = getFontCharOffset(c);
  if (offset == -1)
  {
    memset(buf, 0, size);
    size = 0;
  }
  else
  {
    size = min(size, pgm_read_byte(_fontData+offset));

    offset++; // skip the size byte

    for (uint8_t i=0; i<size; i++)
      *buf++ = pgm_read_byte(_fontData+offset+i);
  }
  
  return(size);
}

uint8_t MD_MAX72XX::setChar(uint16_t col, uint8_t c)
{
  PRINT("\nsetChar: '", c);
  PRINT("' column ", col);
  boolean b = _updateEnabled;
  uint8_t size;

  int16_t offset = getFontCharOffset(c);
  if (offset == -1)
    return(0);

  size = pgm_read_byte(_fontData+offset);

  offset++; // skip the size byte

  _updateEnabled = false;
  for (int8_t i=0; i<size; i++)
  {
    uint8_t colData = pgm_read_byte(_fontData+offset+i);
    setColumn(col--, colData);
  }
  _updateEnabled = b;

  if (_updateEnabled) flushBufferAll();

  return(size);
}

// Standard font - variable spacing
MD_MAX72XX::fontType_t PROGMEM _sysfont_var[] =
{
  'F', 1, 0, 255, 8,
  0,  // 0 - 'Empty Cell'
  5, 0x3e, 0x5b, 0x4f, 0x5b, 0x3e,  // 1 - 'Sad Smiley'
  5, 0x3e, 0x6b, 0x4f, 0x6b, 0x3e,  // 2 - 'Happy Smiley'
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  5, 0xff, 0xff, 0xff, 0xff, 0xff,  // 255 - 'Full Block'
};

#endif //INCLUDE_LOCAL_FONT

